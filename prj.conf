## CMakeLists.txt
```
#
# Copyright (c) 2018 Nordic Semiconductor
#
# SPDX-License-Identifier: LicenseRef-Nordic-5-Clause
#

cmake_minimum_required(VERSION 3.20.0)

set(DTC_OVERLAY_FILE "dts.overlay")

find_package(Zephyr REQUIRED HINTS $ENV{ZEPHYR_BASE})
project(reach-nrfc)

include_directories(
	./include
	./reach-c-stack/include
	./reach-c-stack/third_party/nanopb
	./Integrations/nRFConnect
)

target_sources(app PRIVATE
	src/main.c
	src/fs_utils.c
	src/const_files.c
	src/cli.c
	src/commands.c
	src/device.c
	src/files.c
	src/parameters.c
	src/time.c

	reach-c-stack/src/cr_files.c
	reach-c-stack/src/cr_params.c
	reach-c-stack/src/cr_stack.c
	reach-c-stack/src/cr_streams.c
	reach-c-stack/src/crcb_weak.c
	reach-c-stack/src/i3_log.c
	reach-c-stack/src/message_util.c
	reach-c-stack/src/reach_decode.c
	reach-c-stack/src/reach.pb.c
	reach-c-stack/third_party/nanopb/pb_common.c
	reach-c-stack/third_party/nanopb/pb_decode.c
	reach-c-stack/third_party/nanopb/pb_encode.c

	Integrations/nRFConnect/reach_nrf_connect.c
)

zephyr_library_include_directories(${ZEPHYR_BASE}/samples/bluetooth)
```

## Kconfig
```
source "Kconfig.zephyr"

menu "nRF Connect Reach Demo"

endmenu
```

## prj.conf
```kconfig
#
# Copyright (c) 2018 Nordic Semiconductor
#
# SPDX-License-Identifier: LicenseRef-Nordic-5-Clause
#
CONFIG_NCS_SAMPLES_DEFAULTS=y

CONFIG_LOG=n
CONFIG_ASSERT=n

CONFIG_NEWLIB_LIBC=y
CONFIG_NEWLIB_LIBC_FLOAT_PRINTF=y

CONFIG_FPU=y
CONFIG_POSIX_CLOCK=y

CONFIG_BT=y
CONFIG_BT_SMP=n
CONFIG_SETTINGS=n
CONFIG_BT_ASSERT=n
CONFIG_BT_ASSERT_VERBOSE=n

CONFIG_BT_PERIPHERAL=y
CONFIG_BT_DEVICE_NAME="Reacher nRF52840"
CONFIG_BT_DEVICE_APPEARANCE=833
CONFIG_BT_MAX_CONN=1
CONFIG_BT_PHY_UPDATE=n
CONFIG_BT_GATT_CLIENT=y
CONFIG_BT_GATT_AUTO_UPDATE_MTU=y

CONFIG_BT_BUF_ACL_RX_SIZE=251
CONFIG_BT_ATT_PREPARE_COUNT=2
CONFIG_BT_L2CAP_TX_BUF_COUNT=10
CONFIG_BT_L2CAP_TX_MTU=251
CONFIG_BT_CONN_TX_MAX=10
CONFIG_BT_BUF_ACL_TX_COUNT=10
CONFIG_BT_BUF_ACL_TX_SIZE=251

CONFIG_BT_USER_DATA_LEN_UPDATE=n

CONFIG_DK_LIBRARY=y
CONFIG_DK_LIBRARY_DYNAMIC_BUTTON_HANDLERS=y

# For file system
CONFIG_MAIN_STACK_SIZE=4096
CONFIG_FLASH=y
CONFIG_FLASH_MAP=y
CONFIG_FLASH_PAGE_LAYOUT=y
CONFIG_FILE_SYSTEM=y
CONFIG_FILE_SYSTEM_LITTLEFS=y

# For OTA updates
CONFIG_STREAM_FLASH=y
CONFIG_BOOTLOADER_MCUBOOT=y

# Ensure an MCUboot-compatible binary is generated.
CONFIG_IMG_MANAGER=y
CONFIG_MCUBOOT_IMG_MANAGER=y
CONFIG_IMG_ERASE_PROGRESSIVELY=y
CONFIG_MCUBOOT_GENERATE_UNSIGNED_IMAGE=y
CONFIG_MCUBOOT_GENERATE_CONFIRMED_IMAGE=y
```

## src/main.c
```c
/********************************************************************************************
 *
 * \date   2024
 *
 * \author i3 Product Development (JNP)
 *
 * \brief  Setup and main UI code for the nRF Connect demo.  Based on the BLE throughput sample code.
 *
 ********************************************************************************************/

#include "main.h"

#include <zephyr/kernel.h>
#include <zephyr/device.h>
#include <zephyr/dfu/mcuboot.h>
#include <zephyr/fs/fs.h>
#include <zephyr/fs/littlefs.h>
#include <zephyr/posix/time.h>
#include <zephyr/storage/flash_map.h>

#include <dk_buttons_and_leds.h>

#include "i3_log.h"

#include "reach_nrf_connect.h"
#include "cli.h"
#include "files.h"
#include "parameters.h"

static int littlefs_flash_erase(unsigned int id);
static int littlefs_mount(struct fs_mount_t *mp);

static void identify_task(void *arg, void *param2, void *param3);
static void set_identify(bool en);
static void button_handler_cb(uint32_t button_state, uint32_t has_changed);

#define PARTITION_NODE DT_NODELABEL(lfs1)

#if DT_NODE_EXISTS(PARTITION_NODE)
FS_FSTAB_DECLARE_ENTRY(PARTITION_NODE);
#else /* PARTITION_NODE */
FS_LITTLEFS_DECLARE_DEFAULT_CONFIG(storage);
static struct fs_mount_t lfs_storage_mnt = {
	.type = FS_LITTLEFS,
	.fs_data = &storage,
	.storage_dev = (void *)FIXED_PARTITION_ID(storage_partition),
	.mnt_point = "/lfs",
};
#endif /* PARTITION_NODE */

	struct fs_mount_t *mountpoint =
#if DT_NODE_EXISTS(PARTITION_NODE)
		&FS_FSTAB_ENTRY(PARTITION_NODE)
#else
		&lfs_storage_mnt
#endif
		;

K_THREAD_STACK_DEFINE(identify_task_stack_area, 8192);
static struct k_thread identify_task_data;
static k_tid_t identify_task_id;


static struct button_handler button = {
	.cb = button_handler_cb,
};

static bool identify_enabled = false;
static uint16_t identify_interval_ms = 1000;
static bool identify_led_on = false;
static uint8_t rgb_led_state = RGB_LED_COLOR_OFF;
static bool button_pressed = false;

int main(void)
{
	boot_write_img_confirmed();

	littlefs_mount(mountpoint);

	dk_leds_init();
	dk_buttons_init(NULL);

    identify_task_id = k_thread_create(
        &identify_task_data, identify_task_stack_area,
        K_THREAD_STACK_SIZEOF(identify_task_stack_area),
        identify_task,
        NULL, NULL, NULL,
        2,
        K_FP_REGS,
        K_NO_WAIT);

	dk_button_handler_add(&button);

	parameters_init();
	files_init();
	cli_init();
	rnrfc_init();

	main_set_rgb_led_state(RGB_LED_COLOR_GREEN);

	struct timespec nts;
    nts.tv_sec = (time_t) 0;
    nts.tv_nsec = 0;
    clock_settime(CLOCK_REALTIME, &nts);

	return 0;
}

void main_enable_identify(bool en)
{
	identify_enabled = en;
	k_wakeup(identify_task_id);
}

bool main_identify_enabled(void)
{
	return identify_enabled;
}

void main_set_identify_interval(float seconds)
{
	if (seconds < 0)
		return;
	identify_interval_ms = (uint16_t) ((seconds * 1000) / 2);
	k_wakeup(identify_task_id);
}

bool main_get_identify_led_on(void)
{
	return identify_led_on;
}

uint8_t main_get_rgb_led_state(void)
{
	return rgb_led_state;
}

void main_set_rgb_led_state(uint8_t state)
{
	rgb_led_state = state;
	dk_set_led(1, (state & RGB_LED_STATE_RED) ? 1:0);
	dk_set_led(2, (state & RGB_LED_STATE_GREEN) ? 1:0);
	dk_set_led(3, (state & RGB_LED_STATE_BLUE) ? 1:0);
}

bool main_get_button_pressed(void)
{
	return button_pressed;
}

static int littlefs_flash_erase(unsigned int id)
{
	const struct flash_area *pfa;
	int rc;

	rc = flash_area_open(id, &pfa);
	if (rc < 0) {
		I3_LOG(LOG_MASK_ERROR, "Unable to find flash area %u: %d",
			id, rc);
		return rc;
	}

	I3_LOG(LOG_MASK_ALWAYS, "Area %u at 0x%x on %s for %u bytes",
		   id, (unsigned int)pfa->fa_off, pfa->fa_dev->name,
		   (unsigned int)pfa->fa_size);

	/* Optional wipe flash contents */
	if (IS_ENABLED(CONFIG_APP_WIPE_STORAGE)) {
		rc = flash_area_erase(pfa, 0, pfa->fa_size);
		I3_LOG(LOG_MASK_ERROR, "Erasing flash area ... %d", rc);
	}

	flash_area_close(pfa);
	return rc;
}

static int littlefs_mount(struct fs_mount_t *mp)
{
	int rc;

	rc = littlefs_flash_erase((uintptr_t)mp->storage_dev);
	if (rc < 0) {
		return rc;
	}

	/* Do not mount if auto-mount has been enabled */
#if !DT_NODE_EXISTS(PARTITION_NODE) ||						\
	!(FSTAB_ENTRY_DT_MOUNT_FLAGS(PARTITION_NODE) & FS_MOUNT_FLAG_AUTOMOUNT)
	rc = fs_mount(mp);
	if (rc < 0) {
		I3_LOG(LOG_MASK_ERROR, "Failed to mount ID %" PRIuPTR " at %s, error %d",
		       (uintptr_t)mp->storage_dev, mp->mnt_point, rc);
		return rc;
	}
	I3_LOG(LOG_MASK_ALWAYS, "%s mounted: %d", mp->mnt_point, rc);
#else
	I3_LOG(LOG_MASK_ALWAYS, "%s automounted", mp->mnt_point);
#endif
	return 0;
}

void rnrfc_app_handle_ble_connection(void)
{
	main_set_rgb_led_state(RGB_LED_COLOR_BLUE);
	cr_set_comm_link_connected(true);
	cr_init_param_notifications();
    return;
}

void rnrfc_app_handle_ble_disconnection(void)
{
	main_set_rgb_led_state(RGB_LED_COLOR_GREEN);
    return;
}

static void identify_task(void *arg, void *param2, void *param3)
{
	while (1)
	{
		if (identify_enabled)
		{
			set_identify(!identify_led_on);
			k_msleep(identify_interval_ms);
		}
		else
		{
			set_identify(false);
			// Sleep until woken up by a state change
			k_sleep(K_FOREVER);
		}
	}
}

static void set_identify(bool en)
{
	identify_led_on = en;
	dk_set_led(0, en ? 1:0);
}

static void button_handler_cb(uint32_t button_state, uint32_t has_changed)
{
	ARG_UNUSED(has_changed);
	button_pressed = button_state & DK_BTN1_MSK;
	if (button_pressed)
		main_enable_identify(!identify_enabled);
}
```

## include/app_version.h
```c
/*
 * app_version.h
 *
 *  Version of application
 */

#ifndef _APP_VERSION_H_
#define _APP_VERSION_H_

#define APP_MAJOR_VERSION 0
#define APP_MINOR_VERSION 2
#define APP_PATCH_VERSION 1

// appends a note string to the version
// #define DEV_BUILD

#endif  // ndef _APP_VERSION_H_
```

## include/cli.h
```c
/********************************************************************************************
 *    _ ____  ___             _         _     ___              _                        _
 *   (_)__ / | _ \_ _ ___  __| |_  _ __| |_  |   \ _____ _____| |___ _ __ _ __  ___ _ _| |_
 *   | ||_ \ |  _/ '_/ _ \/ _` | || / _|  _| | |) / -_) V / -_) / _ \ '_ \ '  \/ -_) ' \  _|
 *   |_|___/ |_| |_| \___/\__,_|\_,_\__|\__| |___/\___|\_/\___|_\___/ .__/_|_|_\___|_||_\__|
 *                                                                  |_|
 *                           -----------------------------------
 *                          Copyright i3 Product Development 2024
 *
 * MIT License
 *
 * Permission is hereby granted, free of charge, to any person obtaining a copy
 * of this software and associated documentation files (the "Software"), to deal
 * in the Software without restriction, including without limitation the rights
 * to use, copy, modify, merge, publish, distribute, sublicense, and/or sell
 * copies of the Software, and to permit persons to whom the Software is
 * furnished to do so, subject to the following conditions:
 *
 * The above copyright notice and this permission notice shall be included in all
 * copies or substantial portions of the Software.
 *
 * THE SOFTWARE IS PROVIDED "AS IS", WITHOUT WARRANTY OF ANY KIND, EXPRESS OR
 * IMPLIED, INCLUDING BUT NOT LIMITED TO THE WARRANTIES OF MERCHANTABILITY,
 * FITNESS FOR A PARTICULAR PURPOSE AND NONINFRINGEMENT. IN NO EVENT SHALL THE
 * AUTHORS OR COPYRIGHT HOLDERS BE LIABLE FOR ANY CLAIM, DAMAGES OR OTHER
 * LIABILITY, WHETHER IN AN ACTION OF CONTRACT, TORT OR OTHERWISE, ARISING FROM,
 * OUT OF OR IN CONNECTION WITH THE SOFTWARE OR THE USE OR OTHER DEALINGS IN THE
 * SOFTWARE.
 *
 * \brief A minimal command-line interface implementation
 *
 * Original Author: Chuck Peplinski
 * Script Authors: Joseph Peplinski and Andrew Carlson
 *
 * Generated with version 1.0.0 of the C code generator
 *
 ********************************************************************************************/

#ifndef _CLI_H_
#define _CLI_H_

// Includes
#include <stdbool.h>

/* User code start [cli.h: User Includes] */
/* User code end [cli.h: User Includes] */

// Defines
/* User code start [cli.h: User Defines] */
/* User code end [cli.h: User Defines] */

// Data Types
/* User code start [cli.h: User Data Types] */
/* User code end [cli.h: User Data Types] */

// Global Variables
/* User code start [cli.h: User Global Variables] */
/* User code end [cli.h: User Global Variables] */

// Global Functions
void cli_init(void);
bool cli_poll(void);

/* User code start [cli.h: User Global Functions] */
/* User code end [cli.h: User Global Functions] */


#endif // _CLI_H_
```

## include/commands.h
```c
/********************************************************************************************
 *    _ ____  ___             _         _     ___              _                        _
 *   (_)__ / | _ \_ _ ___  __| |_  _ __| |_  |   \ _____ _____| |___ _ __ _ __  ___ _ _| |_
 *   | ||_ \ |  _/ '_/ _ \/ _` | || / _|  _| | |) / -_) V / -_) / _ \ '_ \ '  \/ -_) ' \  _|
 *   |_|___/ |_| |_| \___/\__,_|\_,_\__|\__| |___/\___|\_/\___|_\___/ .__/_|_|_\___|_||_\__|
 *                                                                  |_|
 *                           -----------------------------------
 *                          Copyright i3 Product Development 2024
 *
 * MIT License
 *
 * Permission is hereby granted, free of charge, to any person obtaining a copy
 * of this software and associated documentation files (the "Software"), to deal
 * in the Software without restriction, including without limitation the rights
 * to use, copy, modify, merge, publish, distribute, sublicense, and/or sell
 * copies of the Software, and to permit persons to whom the Software is
 * furnished to do so, subject to the following conditions:
 *
 * The above copyright notice and this permission notice shall be included in all
 * copies or substantial portions of the Software.
 *
 * THE SOFTWARE IS PROVIDED "AS IS", WITHOUT WARRANTY OF ANY KIND, EXPRESS OR
 * IMPLIED, INCLUDING BUT NOT LIMITED TO THE WARRANTIES OF MERCHANTABILITY,
 * FITNESS FOR A PARTICULAR PURPOSE AND NONINFRINGEMENT. IN NO EVENT SHALL THE
 * AUTHORS OR COPYRIGHT HOLDERS BE LIABLE FOR ANY CLAIM, DAMAGES OR OTHER
 * LIABILITY, WHETHER IN AN ACTION OF CONTRACT, TORT OR OTHERWISE, ARISING FROM,
 * OUT OF OR IN CONNECTION WITH THE SOFTWARE OR THE USE OR OTHER DEALINGS IN THE
 * SOFTWARE.
 *
 * \brief A minimal implementation of command discovery and handling
 *
 * Original Author: Chuck Peplinski
 * Script Authors: Joseph Peplinski and Andrew Carlson
 *
 * Generated with version 1.0.0 of the C code generator
 *
 ********************************************************************************************/

#ifndef _COMMANDS_H_
#define _COMMANDS_H_

// Includes
/* User code start [commands.h: User Includes] */
/* User code end [commands.h: User Includes] */

// Defines
#define NUM_COMMANDS 6

/* User code start [commands.h: User Defines] */
/* User code end [commands.h: User Defines] */

// Data Types
typedef enum {
    COMMAND_PRESET_NOTIFICATIONS_ON,
    COMMAND_CLEAR_NOTIFICATIONS,
    COMMAND_REBOOT,
    COMMAND_RESET_DEFAULTS,
    COMMAND_INVALIDATE_OTA_IMAGE,
    COMMAND_CLICK_FOR_WISDOM,
} command_t;

/* User code start [commands.h: User Data Types] */
/* User code end [commands.h: User Data Types] */

// Global Variables
/* User code start [commands.h: User Global Variables] */
/* User code end [commands.h: User Global Variables] */

// Global Functions
/* User code start [commands.h: User Global Functions] */
/* User code end [commands.h: User Global Functions] */


#endif // _COMMANDS_H_
```

## include/const_files.h
```c
/********************************************************************************************
 *
 * \date   2024
 *
 * \author i3 Product Development (JNP)
 *
 * \brief  Definitions for read-only files and default file contents.
 *
 ********************************************************************************************/

#ifndef CONST_FILES_H_
#define CONST_FILES_H_

#include <stdint.h>

extern const uint8_t cygnus_reach_logo[17900];

extern const char default_io_txt[1296];

#endif // CONST_FILES_H_
```

## include/definitions.h
```c
/********************************************************************************************
 *    _ ____  ___             _         _     ___              _                        _
 *   (_)__ / | _ \_ _ ___  __| |_  _ __| |_  |   \ _____ _____| |___ _ __ _ __  ___ _ _| |_
 *   | ||_ \ |  _/ '_/ _ \/ _` | || / _|  _| | |) / -_) V / -_) / _ \ '_ \ '  \/ -_) ' \  _|
 *   |_|___/ |_| |_| \___/\__,_|\_,_\__|\__| |___/\___|\_/\___|_\___/ .__/_|_|_\___|_||_\__|
 *                                                                  |_|
 *                           -----------------------------------
 *                          Copyright i3 Product Development 2023
 *
 * MIT License
 *
 * Permission is hereby granted, free of charge, to any person obtaining a copy
 * of this software and associated documentation files (the "Software"), to deal
 * in the Software without restriction, including without limitation the rights
 * to use, copy, modify, merge, publish, distribute, sublicense, and/or sell
 * copies of the Software, and to permit persons to whom the Software is
 * furnished to do so, subject to the following conditions:
 *
 * The above copyright notice and this permission notice shall be included in all
 * copies or substantial portions of the Software.
 *
 * THE SOFTWARE IS PROVIDED "AS IS", WITHOUT WARRANTY OF ANY KIND, EXPRESS OR
 * IMPLIED, INCLUDING BUT NOT LIMITED TO THE WARRANTIES OF MERCHANTABILITY,
 * FITNESS FOR A PARTICULAR PURPOSE AND NONINFRINGEMENT. IN NO EVENT SHALL THE
 * AUTHORS OR COPYRIGHT HOLDERS BE LIABLE FOR ANY CLAIM, DAMAGES OR OTHER
 * LIABILITY, WHETHER IN AN ACTION OF CONTRACT, TORT OR OTHERWISE, ARISING FROM,
 * OUT OF OR IN CONNECTION WITH THE SOFTWARE OR THE USE OR OTHER DEALINGS IN THE
 * SOFTWARE.
 *
 * \brief A minimal implementation of Reach data access.  Auto-generated by a Python script.
 *
 * Original Author: Chuck Peplinski
 * Script Author: Joseph Peplinski
 *
 * Generated with version 0.0.1 of c_code_generator.py
 *
 ********************************************************************************************/

#ifndef _DEFINITIONS_H
#define _DEFINITIONS_H

#include "reach.pb.h"

#define INCLUDE_PARAMETER_SERVICE
#define NUM_PARAMS                11
#define NUM_EX_PARAMS             6
#define INCLUDE_FILE_SERVICE
#define NUM_FILES                 3
#define INCLUDE_COMMAND_SERVICE
#define NUM_COMMANDS              4
#define INCLUDE_CLI_SERVICE
#define INCLUDE_TIME_SERVICE

typedef enum {
    PARAM_USER_DEVICE_NAME,
    PARAM_TIMEZONE_ENABLED,
    PARAM_TIMEZONE_OFFSET,
    PARAM_BT_DEVICE_ADDRESS,
    PARAM_UPTIME,
    PARAM_BUTTON_PRESSED,
    PARAM_IDENTIFY_LED_ON,
    PARAM_RGB_LED_STATE,
    PARAM_RGB_LED_COLOR,
    PARAM_IDENTIFY,
    PARAM_IDENTIFY_INTERVAL,
} param_t;

typedef enum {
    RGB_LED_COLOR_OFF,
    RGB_LED_COLOR_RED,
    RGB_LED_COLOR_GREEN,
    RGB_LED_COLOR_YELLOW,
    RGB_LED_COLOR_BLUE,
    RGB_LED_COLOR_MAGENTA,
    RGB_LED_COLOR_CYAN,
    RGB_LED_COLOR_WHITE,
} rgb_led_color_t;

typedef enum {
    RGB_LED_STATE_BIT_INDEX_RED,
    RGB_LED_STATE_BIT_INDEX_GREEN,
    RGB_LED_STATE_BIT_INDEX_BLUE,
} rgb_led_state_indices_t;

typedef enum {
    RGB_LED_STATE_BIT_RED   = (0x1 << RGB_LED_STATE_BIT_INDEX_RED),
    RGB_LED_STATE_BIT_GREEN = (0x1 << RGB_LED_STATE_BIT_INDEX_GREEN),
    RGB_LED_STATE_BIT_BLUE  = (0x1 << RGB_LED_STATE_BIT_INDEX_BLUE),
} rgb_led_state_t;

typedef enum {
    FILE_OTA_BIN,
    FILE_IO_TXT,
    FILE_CYGNUS_REACH_LOGO_PNG,
} file_t;

typedef enum {
    COMMAND_REBOOT,
    COMMAND_RESET_DEFAULTS,
    COMMAND_INVALIDATE_OTA_IMAGE,
    COMMAND_CLICK_FOR_WISDOM,
} command_t;

extern cr_ParameterValue sCr_param_val[NUM_PARAMS];
extern cr_ParameterInfo param_desc[NUM_PARAMS];
extern cr_ParamExInfoResponse param_ex_desc[NUM_EX_PARAMS];
extern cr_FileInfo file_descriptions[NUM_FILES];
extern cr_CommandInfo command_desc[NUM_COMMANDS];

int app_handle_param_repo_pre_init(void);
int app_handle_param_repo_init(cr_ParameterValue *data, cr_ParameterInfo *desc);
int app_handle_param_repo_post_init(void);
int app_handle_param_repo_read(cr_ParameterValue *data);
int app_handle_param_repo_write(cr_ParameterValue *data);

#endif // _DEFINITIONS_H
```

## include/device.h
```c
/********************************************************************************************
 *    _ ____  ___             _         _     ___              _                        _
 *   (_)__ / | _ \_ _ ___  __| |_  _ __| |_  |   \ _____ _____| |___ _ __ _ __  ___ _ _| |_
 *   | ||_ \ |  _/ '_/ _ \/ _` | || / _|  _| | |) / -_) V / -_) / _ \ '_ \ '  \/ -_) ' \  _|
 *   |_|___/ |_| |_| \___/\__,_|\_,_\__|\__| |___/\___|\_/\___|_\___/ .__/_|_|_\___|_||_\__|
 *                                                                  |_|
 *                           -----------------------------------
 *                          Copyright i3 Product Development 2024
 *
 * MIT License
 *
 * Permission is hereby granted, free of charge, to any person obtaining a copy
 * of this software and associated documentation files (the "Software"), to deal
 * in the Software without restriction, including without limitation the rights
 * to use, copy, modify, merge, publish, distribute, sublicense, and/or sell
 * copies of the Software, and to permit persons to whom the Software is
 * furnished to do so, subject to the following conditions:
 *
 * The above copyright notice and this permission notice shall be included in all
 * copies or substantial portions of the Software.
 *
 * THE SOFTWARE IS PROVIDED "AS IS", WITHOUT WARRANTY OF ANY KIND, EXPRESS OR
 * IMPLIED, INCLUDING BUT NOT LIMITED TO THE WARRANTIES OF MERCHANTABILITY,
 * FITNESS FOR A PARTICULAR PURPOSE AND NONINFRINGEMENT. IN NO EVENT SHALL THE
 * AUTHORS OR COPYRIGHT HOLDERS BE LIABLE FOR ANY CLAIM, DAMAGES OR OTHER
 * LIABILITY, WHETHER IN AN ACTION OF CONTRACT, TORT OR OTHERWISE, ARISING FROM,
 * OUT OF OR IN CONNECTION WITH THE SOFTWARE OR THE USE OR OTHER DEALINGS IN THE
 * SOFTWARE.
 *
 * \brief A minimal implementation of device info discovery
 *
 * Original Author: Chuck Peplinski
 * Script Authors: Joseph Peplinski and Andrew Carlson
 *
 * Generated with version 1.0.0 of the C code generator
 *
 ********************************************************************************************/

#ifndef _DEVICE_H_
#define _DEVICE_H_

// Includes
/* User code start [device.h: User Includes] */
/* User code end [device.h: User Includes] */

// Defines
#define INCLUDE_PARAMETER_SERVICE
#define INCLUDE_FILE_SERVICE
#define INCLUDE_COMMAND_SERVICE
#define INCLUDE_CLI_SERVICE
#define INCLUDE_TIME_SERVICE

/* User code start [device.h: User Defines] */
/* User code end [device.h: User Defines] */

// Data Types
/* User code start [device.h: User Data Types] */
/* User code end [device.h: User Data Types] */

// Global Variables
/* User code start [device.h: User Global Variables] */
/* User code end [device.h: User Global Variables] */

// Global Functions
const char *get_app_version();

/* User code start [device.h: User Global Functions] */
/* User code end [device.h: User Global Functions] */


#endif // _DEVICE_H_
```

## include/files.h
```c
/********************************************************************************************
 *    _ ____  ___             _         _     ___              _                        _
 *   (_)__ / | _ \_ _ ___  __| |_  _ __| |_  |   \ _____ _____| |___ _ __ _ __  ___ _ _| |_
 *   | ||_ \ |  _/ '_/ _ \/ _` | || / _|  _| | |) / -_) V / -_) / _ \ '_ \ '  \/ -_) ' \  _|
 *   |_|___/ |_| |_| \___/\__,_|\_,_\__|\__| |___/\___|\_/\___|_\___/ .__/_|_|_\___|_||_\__|
 *                                                                  |_|
 *                           -----------------------------------
 *                          Copyright i3 Product Development 2024
 *
 * MIT License
 *
 * Permission is hereby granted, free of charge, to any person obtaining a copy
 * of this software and associated documentation files (the "Software"), to deal
 * in the Software without restriction, including without limitation the rights
 * to use, copy, modify, merge, publish, distribute, sublicense, and/or sell
 * copies of the Software, and to permit persons to whom the Software is
 * furnished to do so, subject to the following conditions:
 *
 * The above copyright notice and this permission notice shall be included in all
 * copies or substantial portions of the Software.
 *
 * THE SOFTWARE IS PROVIDED "AS IS", WITHOUT WARRANTY OF ANY KIND, EXPRESS OR
 * IMPLIED, INCLUDING BUT NOT LIMITED TO THE WARRANTIES OF MERCHANTABILITY,
 * FITNESS FOR A PARTICULAR PURPOSE AND NONINFRINGEMENT. IN NO EVENT SHALL THE
 * AUTHORS OR COPYRIGHT HOLDERS BE LIABLE FOR ANY CLAIM, DAMAGES OR OTHER
 * LIABILITY, WHETHER IN AN ACTION OF CONTRACT, TORT OR OTHERWISE, ARISING FROM,
 * OUT OF OR IN CONNECTION WITH THE SOFTWARE OR THE USE OR OTHER DEALINGS IN THE
 * SOFTWARE.
 *
 * \brief A minimal implementation of file discovery and read/write handling
 *
 * Original Author: Chuck Peplinski
 * Script Authors: Joseph Peplinski and Andrew Carlson
 *
 * Generated with version 1.0.0 of the C code generator
 *
 ********************************************************************************************/

#ifndef _FILES_H_
#define _FILES_H_

// Includes
#include "cr_stack.h"

/* User code start [files.h: User Includes] */
/* User code end [files.h: User Includes] */

// Defines
#define NUM_FILES 3

/* User code start [files.h: User Defines] */
/* User code end [files.h: User Defines] */

// Data Types
typedef enum {
    FILE_OTA_BIN,
    FILE_IO_TXT,
    FILE_CYGNUS_REACH_LOGO_PNG,
} file_t;

/* User code start [files.h: User Data Types] */
/* User code end [files.h: User Data Types] */

// Global Variables
/* User code start [files.h: User Global Variables] */
/* User code end [files.h: User Global Variables] */

// Global Functions
void files_init(void);
int files_set_description(uint32_t fid, cr_FileInfo *file_desc);

/* User code start [files.h: User Global Functions] */
void files_reset(void);
int ota_invalidate(void);
/* User code end [files.h: User Global Functions] */


#endif // _FILES_H_
```

## include/fs_utils.h
```c
/********************************************************************************************
 *
 * \date   2024
 *
 * \author i3 Product Development (JNP)
 *
 * \brief  Utilities to simplify common file access patterns
 *
 ********************************************************************************************/

#include <stdint.h>
#include <stddef.h>

/**
 * Checks if the specified file exists on the file system
 * @param path The path of the file to look for
 * @return 1 if the file exists, 0 if the file does not exist, or a negative error code on file system error
 */
int fs_utils_file_exists(char *path);

/**
 * Gets the file size of the requested file
 * @param path The path of the file to look for
 * @return The size of the file if successful, 0 if the file does not exist, or a negative error code on file system error
 */
int fs_utils_get_file_size(char *path);

/**
 * Gets the contents of the requested file (if it exists)
 * @param path The path of the file to look for
 * @param data A pointer to the array to fill with the file contents
 * @param offset Where to start reading the file from
 * @param size A pointer to the size of the provided array, which will be updated to reflect the size of the file contents
 * @return 0 on success, or a negative error code on failure (including if the file does not exist)
 */
int fs_utils_get_file(char *fname, uint8_t *data, int32_t offset, size_t *size);

/**
 * Writes a new file to the specified path with the provided contents, erasing any existing file at that path
 * @param path The path of the file to create
 * @param data A pointer to the new file contents
 * @param size The size of the new file contents
 * @return 0 on success, or a negative error code on failure
 */
int fs_utils_update_file(char *fname, uint8_t *data, size_t size);

/**
 * Erases the specified file
 * @param path The path of the file to erase
 * @return 0 on success (including if the file did not exist), or a negative error code on failure
 */
int fs_utils_erase_file(char *fname);
```

## include/main.h
```c
/********************************************************************************************
 *
 * \date   2024
 *
 * \author i3 Product Development (JNP)
 *
 * \brief  Setup and main UI code for the nRF Connect demo.  Based on the BLE throughput sample code.
 *
 ********************************************************************************************/

#ifndef MAIN_H_
#define MAIN_H_

#include <stdbool.h>
#include <stdint.h>

void main_enable_identify(bool en);
bool main_identify_enabled(void);
void main_set_identify_interval(float seconds);
bool main_get_identify_led_on(void);
uint8_t main_get_rgb_led_state(void);
void main_set_rgb_led_state(uint8_t state);
bool main_get_button_pressed(void);

#endif /* MAIN_H_ */
```

## include/parameters.h
```c
/********************************************************************************************
 *    _ ____  ___             _         _     ___              _                        _
 *   (_)__ / | _ \_ _ ___  __| |_  _ __| |_  |   \ _____ _____| |___ _ __ _ __  ___ _ _| |_
 *   | ||_ \ |  _/ '_/ _ \/ _` | || / _|  _| | |) / -_) V / -_) / _ \ '_ \ '  \/ -_) ' \  _|
 *   |_|___/ |_| |_| \___/\__,_|\_,_\__|\__| |___/\___|\_/\___|_\___/ .__/_|_|_\___|_||_\__|
 *                                                                  |_|
 *                           -----------------------------------
 *                          Copyright i3 Product Development 2024
 *
 * MIT License
 *
 * Permission is hereby granted, free of charge, to any person obtaining a copy
 * of this software and associated documentation files (the "Software"), to deal
 * in the Software without restriction, including without limitation the rights
 * to use, copy, modify, merge, publish, distribute, sublicense, and/or sell
 * copies of the Software, and to permit persons to whom the Software is
 * furnished to do so, subject to the following conditions:
 *
 * The above copyright notice and this permission notice shall be included in all
 * copies or substantial portions of the Software.
 *
 * THE SOFTWARE IS PROVIDED "AS IS", WITHOUT WARRANTY OF ANY KIND, EXPRESS OR
 * IMPLIED, INCLUDING BUT NOT LIMITED TO THE WARRANTIES OF MERCHANTABILITY,
 * FITNESS FOR A PARTICULAR PURPOSE AND NONINFRINGEMENT. IN NO EVENT SHALL THE
 * AUTHORS OR COPYRIGHT HOLDERS BE LIABLE FOR ANY CLAIM, DAMAGES OR OTHER
 * LIABILITY, WHETHER IN AN ACTION OF CONTRACT, TORT OR OTHERWISE, ARISING FROM,
 * OUT OF OR IN CONNECTION WITH THE SOFTWARE OR THE USE OR OTHER DEALINGS IN THE
 * SOFTWARE.
 *
 * \brief A minimal implementation of Reach data access.
 *
 * Original Author: Chuck Peplinski
 * Script Authors: Joseph Peplinski and Andrew Carlson
 *
 * Generated with version 1.0.0 of the C code generator
 *
 ********************************************************************************************/

#ifndef _PARAMETERS_H_
#define _PARAMETERS_H_

// Includes
#include <stdbool.h>
#include <stdint.h>

/* User code start [parameters.h: User Includes] */
/* User code end [parameters.h: User Includes] */

// Defines
#define NUM_PARAMS 11
#define NUM_DEFAULT_PARAMETER_NOTIFICATIONS 8
#define NUM_EX_PARAMS 3

/* User code start [parameters.h: User Defines] */
/* User code end [parameters.h: User Defines] */

// Data Types
typedef enum {
    PARAM_USER_DEVICE_NAME,
    PARAM_TIMEZONE_ENABLED,
    PARAM_TIMEZONE_OFFSET,
    PARAM_BT_DEVICE_ADDRESS,
    PARAM_UPTIME,
    PARAM_BUTTON_PRESSED,
    PARAM_IDENTIFY_LED,
    PARAM_RGB_LED_STATE,
    PARAM_RGB_LED_COLOR,
    PARAM_IDENTIFY,
    PARAM_IDENTIFY_INTERVAL,
} param_t;

typedef enum {
    PARAM_EI_IDENTIFY_LED,
    PARAM_EI_RGB_LED_STATE,
    PARAM_EI_RGB_LED_COLOR,
} param_ei_t;

typedef enum {
    RGB_LED_STATE_INDICES_RED,
    RGB_LED_STATE_INDICES_GREEN,
    RGB_LED_STATE_INDICES_BLUE,
} rgb_led_state_indices_t;

typedef enum {
    RGB_LED_STATE_RED   = (0b1 << RGB_LED_STATE_INDICES_RED),
    RGB_LED_STATE_GREEN = (0b1 << RGB_LED_STATE_INDICES_GREEN),
    RGB_LED_STATE_BLUE  = (0b1 << RGB_LED_STATE_INDICES_BLUE),
} rgb_led_state_t;

typedef enum {
    RGB_LED_COLOR_OFF,
    RGB_LED_COLOR_RED,
    RGB_LED_COLOR_GREEN,
    RGB_LED_COLOR_YELLOW,
    RGB_LED_COLOR_BLUE,
    RGB_LED_COLOR_MAGENTA,
    RGB_LED_COLOR_CYAN,
    RGB_LED_COLOR_WHITE,
} rgb_led_color_t;

/* User code start [parameters.h: User Data Types] */
/* User code end [parameters.h: User Data Types] */

// Global Variables
/* User code start [parameters.h: User Global Variables] */
/* User code end [parameters.h: User Global Variables] */

// Global Functions
void parameters_init(void);
int parameters_reset_param(param_t pid, bool write, uint32_t write_timestamp);
const char *parameters_get_ei_label(int32_t pei_id, uint32_t enum_bit_position);

/* User code start [parameters.h: User Global Functions] */
int parameters_reset_nvm(void);
/* User code end [parameters.h: User Global Functions] */


#endif // _PARAMETERS_H_
```

## include/reach-server.h
```c
/********************************************************************************************
 *    _ ____  ___             _         _     ___              _                        _
 *   (_)__ / | _ \_ _ ___  __| |_  _ __| |_  |   \ _____ _____| |___ _ __ _ __  ___ _ _| |_
 *   | ||_ \ |  _/ '_/ _ \/ _` | || / _|  _| | |) / -_) V / -_) / _ \ '_ \ '  \/ -_) ' \  _|
 *   |_|___/ |_| |_| \___/\__,_|\_,_\__|\__| |___/\___|\_/\___|_\___/ .__/_|_|_\___|_||_\__|
 *                                                                  |_|
 *                           -----------------------------------
 *                          Copyright i3 Product Development 2023
 *
 * MIT License
 *
 * Permission is hereby granted, free of charge, to any person obtaining a copy
 * of this software and associated documentation files (the "Software"), to deal
 * in the Software without restriction, including without limitation the rights
 * to use, copy, modify, merge, publish, distribute, sublicense, and/or sell
 * copies of the Software, and to permit persons to whom the Software is
 * furnished to do so, subject to the following conditions:
 *
 * The above copyright notice and this permission notice shall be included in all
 * copies or substantial portions of the Software.
 *
 * THE SOFTWARE IS PROVIDED "AS IS", WITHOUT WARRANTY OF ANY KIND, EXPRESS OR
 * IMPLIED, INCLUDING BUT NOT LIMITED TO THE WARRANTIES OF MERCHANTABILITY,
 * FITNESS FOR A PARTICULAR PURPOSE AND NONINFRINGEMENT. IN NO EVENT SHALL THE
 * AUTHORS OR COPYRIGHT HOLDERS BE LIABLE FOR ANY CLAIM, DAMAGES OR OTHER
 * LIABILITY, WHETHER IN AN ACTION OF CONTRACT, TORT OR OTHERWISE, ARISING FROM,
 * OUT OF OR IN CONNECTION WITH THE SOFTWARE OR THE USE OR OTHER DEALINGS IN THE
 * SOFTWARE.
 *
 * \brief This file specifies aspects of the Reach server that are controlled by the app.
 *
 * Original Author: Chuck.Peplinski
 *
 ********************************************************************************************/

#ifndef _REACH_SERVER_H_
#define _REACH_SERVER_H_

#include "device.h"
#include "parameters.h"

// A range of parameters are driven by the 244 byte packet size imposed by BLE.


// As the app is using BLE, the largest encoded buffer cannot be larger than 
// 244 bytes.  The Reach stack will statically allocate two buffers of this size, 
// for encoding and decoding
#define CR_CODED_BUFFER_SIZE    244

// The raw data that encodes to BLE might be slightly larger.
// The Reach stack will allocate one buffer of this size, for decoding the prompt.
// The app is to provide the raw memory to be encoded.
#define CR_DECODED_BUFFER_SIZE   256

#define APP_ADVERTISED_NAME_LENGTH 30

// Use this to set the default logging level.  0x0 will only report high-priority text and warnings/errors
#define DEFAULT_LOG_MASK 0x0

// Define this to be a 32 bit number that must be provided to access the device.
// #define APP_REQUIRED_CHALLENGE_KEY  0x1020304

// Define this to be a 32 bit number that must be provided to access a longer
// list of parameters.
// #define APP_REQUIRED_PARAMETER_KEY  0x9080706

// Setting this to zero removes support for unpolled parameter change notification
// Defines the size of the array holding param notification specifications.
#define NUM_SUPPORTED_PARAM_NOTIFY  NUM_PARAMS

// Configuration of error reporting by cr_report_error()
#define ERROR_FORMAT_LOG_ONLY   0  // only log to console
#define ERROR_FORMAT_SHORT      1  // send error code only to client
#define ERROR_FORMAT_FULL       2  // send error message to client.
#define ERROR_REPORT_FORMAT     ERROR_FORMAT_FULL

#include "reach.pb.h"

// Ideally all of the buffer sizes flow from here.
#include "reach_ble_proto_sizes.h"

// This is the number of buffers allocated.
// It's coded here to be the same as the number allowed in a transfer.
// With code changes it could be less.
#define REACH_PARAM_BUFFER_COUNT REACH_COUNT_PARAM_IDS

#define AHSOKA_HEADER

#endif  // ndef _REACH_SERVER_H_
```
